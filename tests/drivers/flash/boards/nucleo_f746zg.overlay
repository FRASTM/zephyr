/*
 * Copyright (c) 2022 STMicroelectronics
 *
 * SPDX-License-Identifier: Apache-2.0
 */

&flash0 {
	partitions {
		compatible = "fixed-partitions";
		#address-cells = <1>;
		#size-cells = <1>;

		/* Set 2KB of storage at the end of 1MB flash */
		storage_partition: partition@c0000 {
			label = "storage";
			reg = <0x000c0000 0x00000800>;
		};
	};
};
