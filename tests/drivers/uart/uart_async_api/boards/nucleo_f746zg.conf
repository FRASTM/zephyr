## tests/drivers/uart/uart_async_api/boards/nucleo_wb55rg.conf
```kconfig
CONFIG_PM=y
CONFIG_DEBUG=y
CONFIG_LOG=y
CONFIG_UART_LOG_LEVEL_ERR=y
CONFIG_DMA_LOG_LEVEL_ERR=y
```

## tests/kernel/timer/timer_behavior/boards/nucleo_l073rz.conf
```kconfig
# decrease TICKS_PER_SEC for sysclock at 32MHz
CONFIG_SYS_CLOCK_TICKS_PER_SEC=8000
```

## tests/kernel/timer/timer_behavior/boards/nucleo_wba55cg.conf
```kconfig
# decrease TICKS_PER_SEC for low sysclock freq.
CONFIG_SYS_CLOCK_TICKS_PER_SEC=8000
```
