/*
 * Copyright (c) 2026 STMicroelectronics
 *
 * SPDX-License-Identifier: Apache-2.0
 */

dut: &usart1 {
	dmas = <&gpdma1 2 74 STM32_DMA_PERIPH_TX>,
	       <&gpdma1 3 73 STM32_DMA_PERIPH_RX>;
	dma-names = "tx", "rx";
};
