/*
 * Copyright (c) 2025 STMicroelectronics
 *
 * SPDX-License-Identifier: Apache-2.0
 */

/*
 * Warning: This overlay performs configuration from clean sheet.
 * It is assumed that it is applied after h7rs_core_init.overlay file.
 */

&pll2 {
	clocks = <&clk_hse>;
	div-m = <4>;
	mul-n = <96>;
	div-p = <6>;
	status = "okay";
};

&spi1 {
	/delete-property/ clocks;
	clocks = <&rcc STM32_CLOCK_BUS_APB2 0x00001000>,
		 <&rcc STM32_SRC_PLL2_P SPI1_SEL(1)>;
	status = "okay";
};
