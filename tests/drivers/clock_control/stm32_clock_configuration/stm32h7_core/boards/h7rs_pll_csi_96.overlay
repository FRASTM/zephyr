/*
 * Copyright (c) 2025 STMicroelectronics
 *
 * SPDX-License-Identifier: Apache-2.0
 */

/*
 * Warning: This overlay performs configuration from clean sheet.
 * It is assumed that it is applied after h7rs_clear_clocks.overlay file.
 */

&clk_csi {
	status = "okay";	/* CSI RC: 4MHz */
};

&pll {
	div-m = <1>;
	mul-n = <144>;
	div-p = <6>;
	div-q = <6>;
	clocks = <&clk_csi>;
	status = "okay";
};

&rcc {
	clocks = <&pll>;
	clock-frequency = <DT_FREQ_M(96)>;
	dcpre = <1>;
	hpre = <1>;
	ppre1 = <1>;
	ppre2 = <1>;
	ppre4 = <1>;
	ppre5 = <1>;
};
