/*
 * Copyright (c) 2025 STMicroelectronics
 *
 * SPDX-License-Identifier: Apache-2.0
 */

/*
 * Warning: This overlay performs configuration from clean sheet.
 * It is assumed that it is applied after h7rs_clear_clocks.overlay file.
 */

&clk_hse {
	clock-frequency = <DT_FREQ_M(24)>;
	status = "okay";
};

&rcc {
	clocks = <&clk_hse>;
	clock-frequency = <DT_FREQ_M(24)>;
	dcpre = <1>;
	hpre = <1>;
	ppre1 = <1>;
	ppre2 = <1>;
	ppre4 = <1>;
	ppre5 = <1>;
};
