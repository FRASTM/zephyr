## tests/drivers/clock_control/stm32_clock_configuration/stm32h5_devices/testcase.yaml
```yaml
common:
  timeout: 5
  tags: clock_control

tests:
  drivers.clock.stm32_clock_configuration.h5.perck_source_hsi:
    extra_args: DTC_OVERLAY_FILE="boards/clear_clocks.overlay;boards/spi2_perck_hsi.overlay"
    platform_allow: stm32h573i_dk
    drivers.clock.stm32_clock_configuration.h5.perck_source_csi:
      extra_args: DTC_OVERLAY_FILE="boards/clear_clocks.overlay;boards/spi2_perck_csi.overlay"
      platform_allow: stm32h573i_dk
      drivers.clock.stm32_clock_configuration.h5.perck_source_hse:
        extra_args: DTC_OVERLAY_FILE="boards/clear_clocks.overlay;boards/spi2_perck_hse.overlay"
        platform_allow: stm32h573i_dk
```

## tests/drivers/clock_control/stm32_clock_configuration/stm32h7_core/testcase.yaml
```yaml
common:
  timeout: 5
  tags: clock_control
tests:
  drivers.clock.stm32_clock_configuration.h7_core.sysclksrc_pll_hse_96:
    extra_args: DTC_OVERLAY_FILE="boards/clear_clocks.overlay;boards/pll_hse_96.overlay"
    platform_allow:
      - nucleo_h743zi
    integration_platforms:
      - nucleo_h743zi
  drivers.clock.stm32_clock_configuration.h7_core.sysclksrc_pll_hsi_96:
    extra_args: DTC_OVERLAY_FILE="boards/clear_clocks.overlay;boards/pll_hsi_96.overlay"
    platform_allow:
      - nucleo_h743zi
    integration_platforms:
      - nucleo_h743zi
  drivers.clock.stm32_clock_configuration.h7_core.sysclksrc_hsi_64:
    extra_args: DTC_OVERLAY_FILE="boards/clear_clocks.overlay;boards/hsi_64.overlay"
    platform_allow:
      - nucleo_h743zi
    integration_platforms:
      - nucleo_h743zi
  drivers.clock.stm32_clock_configuration.h7_core.sysclksrc_csi_4:
    extra_args: DTC_OVERLAY_FILE="boards/clear_clocks.overlay;boards/csi_4.overlay"
    platform_allow:
      - nucleo_h743zi
    integration_platforms:
      - nucleo_h743zi
  drivers.clock.stm32_clock_configuration.h7_core.sysclksrc_hse_8:
    extra_args: DTC_OVERLAY_FILE="boards/clear_clocks.overlay;boards/hse_8.overlay"
    platform_allow:
      - nucleo_h743zi
    integration_platforms:
      - nucleo_h743zi
  drivers.clock.stm32_clock_configuration.h7_core.sysclksrc_hse_8_css:
    extra_args:
      DTC_OVERLAY_FILE="boards/clear_clocks.overlay;boards/hse_8.overlay;boards/hse_css.overlay"
    platform_allow:
      - nucleo_h743zi
    integration_platforms:
      - nucleo_h743zi
  drivers.clock.stm32_clock_configuration.h7_core.sysclksrc_pll_csi_96:
    extra_args: DTC_OVERLAY_FILE="boards/clear_clocks.overlay;boards/pll_csi_96.overlay"
    platform_allow: nucleo_h743zi
    integration_platforms:
      - nucleo_h743zi
  drivers.clock.stm32_clock_configuration.h7_core.sysclksrc_pll_hse_550:
    extra_args: DTC_OVERLAY_FILE="boards/clear_clocks.overlay;boards/pll_hse_550.overlay"
    platform_allow:
      - nucleo_h723zg
      - stm32h735g_disco
    integration_platforms:
      - nucleo_h723zg
  drivers.clock.stm32_clock_configuration.h7_core.sysclksrc_pll_hsi_fracn_550:
    extra_args: DTC_OVERLAY_FILE="boards/clear_clocks.overlay;boards/pll_hsi_fracn_550.overlay"
    platform_allow:
      - nucleo_h723zg
      - stm32h735g_disco
    integration_platforms:
      - nucleo_h723zg
  drivers.clock.stm32_clock_configuration.h7rs_core.sysclksrc_pll_hse_96:
    extra_args: DTC_OVERLAY_FILE="boards/h7rs_clear_clocks.overlay;boards/h7rs_pll_hse_96.overlay"
    platform_allow:
      - nucleo_h7s3l8
    integration_platforms:
      - nucleo_h7s3l8
  drivers.clock.stm32_clock_configuration.h7rs_core.sysclksrc_pll_hse_bp_96:
    extra_args: DTC_OVERLAY_FILE="boards/h7rs_clear_clocks.overlay;boards/h7rs_pll_hse_96.overlay"
    platform_allow:
      - stm32h7s78_dk
    integration_platforms:
      - stm32h7s78_dk
  drivers.clock.stm32_clock_configuration.h7rs_core.sysclksrc_pll_hsi_96:
    extra_args: DTC_OVERLAY_FILE="boards/h7rs_clear_clocks.overlay;boards/h7rs_pll_hsi_96.overlay"
    platform_allow:
      - nucleo_h7s3l8
      - stm32h7s78_dk
    integration_platforms:
      - stm32h7s78_dk
  drivers.clock.stm32_clock_configuration.h7rs_core.sysclksrc_hsi_64:
    extra_args: DTC_OVERLAY_FILE="boards/h7rs_clear_clocks.overlay;boards/h7rs_hsi_64.overlay"
    platform_allow:
      - nucleo_h7s3l8
      - stm32h7s78_dk
    integration_platforms:
      - stm32h7s78_dk
  drivers.clock.stm32_clock_configuration.h7rs_core.sysclksrc_csi_4:
    extra_args: DTC_OVERLAY_FILE="boards/h7rs_clear_clocks.overlay;boards/h7rs_csi_4.overlay"
    platform_allow:
      - nucleo_h7s3l8
      - stm32h7s78_dk
    integration_platforms:
      - stm32h7s78_dk
  drivers.clock.stm32_clock_configuration.h7rs_core.sysclksrc_hse_24:
    extra_args: DTC_OVERLAY_FILE="boards/h7rs_clear_clocks.overlay;boards/h7rs_hse_24.overlay"
    platform_allow:
      - nucleo_h7s3l8
    integration_platforms:
      - nucleo_h7s3l8
  drivers.clock.stm32_clock_configuration.h7rs_core.sysclksrc_hse_bp_24:
    extra_args:
      DTC_OVERLAY_FILE="boards/h7rs_clear_clocks.overlay;boards/h7rs_hse_bp_24.overlay"
    platform_allow:
      - stm32h7s78_dk
    integration_platforms:
      - stm32h7s78_dk
  drivers.clock.stm32_clock_configuration.h7rs_core.sysclksrc_hse_24_css:
    extra_args:
      DTC_OVERLAY_FILE="boards/h7rs_clear_clocks.overlay;boards/h7rs_hse_bp_24.overlay;boards/hse_css.overlay"
    platform_allow:
      - stm32h7s78_dk
    integration_platforms:
      - stm32h7s78_dk
  drivers.clock.stm32_clock_configuration.h7rs_core.sysclksrc_pll_csi_96:
    extra_args: DTC_OVERLAY_FILE="boards/h7rs_clear_clocks.overlay;boards/h7rs_pll_csi_96.overlay"
    platform_allow:
      - nucleo_h7s3l8
      - stm32h7s78_dk
    integration_platforms:
      - stm32h7s78_dk
  drivers.clock.stm32_clock_configuration.h7rs_core.sysclksrc_pll_hse_500:
    extra_args: DTC_OVERLAY_FILE="boards/h7rs_clear_clocks.overlay;boards/h7rs_pll_hse_500.overlay"
    platform_allow:
      - nucleo_h7s3l8
    integration_platforms:
      - nucleo_h7s3l8
  drivers.clock.stm32_clock_configuration.h7rs_core.sysclksrc_pll_hse_bp_500:
    extra_args: DTC_OVERLAY_FILE="boards/h7rs_clear_clocks.overlay;boards/h7rs_pll_hse_bp_500.overlay"
    platform_allow:
      - stm32h7s78_dk
    integration_platforms:
      - stm32h7s78_dk
```

## tests/drivers/clock_control/stm32_clock_configuration/stm32h7_devices/testcase.yaml
```yaml
common:
  timeout: 5
tests:
  drivers.clock.stm32_clock_configuration.h7_dev.spi1_pllq_1_d1ppre_1:
    extra_args: DTC_OVERLAY_FILE="boards/core_init.overlay;boards/spi1_pllq_1_d1ppre_1.overlay"
    platform_allow:
      - nucleo_h723zg
  drivers.clock.stm32_clock_configuration.h7_dev.spi1_pllq_2_d1ppre_4:
    extra_args: DTC_OVERLAY_FILE="boards/core_init.overlay;boards/spi1_pllq_2_d1ppre_4.overlay"
    platform_allow:
      - nucleo_h723zg
  drivers.clock.stm32_clock_configuration.h7_dev.spi1_pll2p_1:
    extra_args: DTC_OVERLAY_FILE="boards/core_init.overlay;boards/spi1_pll2p_1.overlay"
    platform_allow:
      - nucleo_h723zg
  drivers.clock.stm32_clock_configuration.h7_dev.spi1_pll3p_1_d1ppre_4:
    extra_args: DTC_OVERLAY_FILE="boards/core_init.overlay;boards/spi1_pll3p_1_d1ppre_4.overlay"
    platform_allow:
      - nucleo_h723zg
  drivers.clock.stm32_clock_configuration.h7_dev.spi1_per_ck_d1ppre_1:
    extra_args: DTC_OVERLAY_FILE="boards/core_init.overlay;boards/spi1_per_ck_d1ppre_1.overlay"
    platform_allow:
      - nucleo_h723zg
  drivers.clock.stm32_clock_configuration.h7_dev.spi1_per_ck_hsi:
    extra_args: DTC_OVERLAY_FILE="boards/core_init.overlay;boards/spi1_per_ck_hsi.overlay"
    platform_allow:
      - nucleo_h723zg
  drivers.clock.stm32_clock_configuration.h7_dev.spi1_per_ck_hse:
    extra_args: DTC_OVERLAY_FILE="boards/core_init.overlay;boards/spi1_per_ck_hse.overlay"
    platform_allow:
      - nucleo_h723zg
  drivers.clock.stm32_clock_configuration.h7rs_dev.spi1_pllq_1_ppre1_1:
    extra_args: DTC_OVERLAY_FILE="boards/h7rs_core_init.overlay;boards/h7rs_spi1_pllq_1_ppre1_1.overlay"
    platform_allow:
      - stm32h7s78_dk
  drivers.clock.stm32_clock_configuration.h7rs_dev.spi1_pllq_2_ppre1_4:
    extra_args: DTC_OVERLAY_FILE="boards/h7rs_core_init.overlay;boards/h7rs_spi1_pllq_2_ppre1_4.overlay"
    platform_allow:
      - stm32h7s78_dk
  drivers.clock.stm32_clock_configuration.h7rs_dev.spi1_pll2p_1:
    extra_args: DTC_OVERLAY_FILE="boards/h7rs_core_init.overlay;boards/h7rs_spi1_pll2p_1.overlay"
    platform_allow:
      - stm32h7s78_dk
  drivers.clock.stm32_clock_configuration.h7rs_dev.spi1_pll3p_1_ppre1_4:
    extra_args: DTC_OVERLAY_FILE="boards/h7rs_core_init.overlay;boards/h7rs_spi1_pll3p_1_ppre1_4.overlay"
    platform_allow:
      - stm32h7s78_dk
  drivers.clock.stm32_clock_configuration.h7rs_dev.spi1_per_ck_d1ppre_1:
    extra_args: DTC_OVERLAY_FILE="boards/h7rs_core_init.overlay;boards/h7rs_spi1_per_ck_ppre1_1.overlay"
    platform_allow:
      - stm32h7s78_dk
  drivers.clock.stm32_clock_configuration.h7rs_dev.spi1_per_ck_hsi:
    extra_args: DTC_OVERLAY_FILE="boards/h7rs_core_init.overlay;boards/h7rs_spi1_per_ck_hsi.overlay"
    platform_allow:
      - stm32h7s78_dk
  drivers.clock.stm32_clock_configuration.h7rs_dev.spi1_per_ck_hse:
    extra_args: DTC_OVERLAY_FILE="boards/h7rs_core_init.overlay;boards/h7rs_spi1_per_ck_hse.overlay"
    platform_allow:
      - stm32h7s78_dk
```

## tests/drivers/i2c/i2c_target_api/testcase.yaml
```yaml
common:
  depends_on: i2c
  tags: drivers i2c
  harness: ztest
  harness_config:
    fixture: i2c_bus_short

tests:
  drivers.i2c.target_api.dual_role:
    platform_allow: nucleo_f091rc stm32f072b_disco nucleo_f746zg nucleo_g071rb nucleo_l152re
        rpi_pico
    extra_configs:
      - CONFIG_APP_DUAL_ROLE_I2C=y
```
