## boards/st/stm32h5f5j_dk/Kconfig.defconfig
```kconfig
# STM32H5F5J DISCOVERY KIT board configuration
#
# Copyright (c) 2026 STMicroelectronics
#
# SPDX-License-Identifier: Apache-2.0
#

if BOARD_STM32H5F5J_DK

if NETWORKING

configdefault NET_L2_ETHERNET
	default y

endif # NETWORKING

if DISK_DRIVER_SDMMC

configdefault SDMMC_STM32_CLOCK_CHECK
	default n

endif # DISK_DRIVER_SDMMC

if DISPLAY

choice ST7789V_PIXEL_FORMAT
	default ST7789V_RGB565X
endchoice

# Required to enable LCD backlight
configdefault REGULATOR
	default y

configdefault INPUT
	default y if LVGL

configdefault I2C_STM32_V2_TIMING
	default y if INPUT

endif # DISPLAY

endif # BOARD_STM32H5F5J_DK
```

## drivers/flash/Kconfig.stm32_mspi
```kconfig
# STM32 MSPI flash driver configuration options

# Copyright (c) 2024 STMicroelectronics
# SPDX-License-Identifier: Apache-2.0

DT_STM32_MSPI_1_HAS_DMA := $(dt_nodelabel_has_prop,mspi1,dmas)
DT_STM32_MSPI_2_HAS_DMA := $(dt_nodelabel_has_prop,mspi2,dmas)

config FLASH_MSPI_STM32
	bool "STM32 XSPI Flash driver"
	default y if FLASH_MSPI
	depends on DT_HAS_ST_STM32_MSPI_CONTROLLER_ENABLED && DT_HAS_ST_STM32_MSPI_NOR_ENABLED
	select USE_STM32_HAL_XSPI
	select USE_STM32_LL_DLYB
	select FLASH_HAS_DRIVER_ENABLED
	select FLASH_JESD216
	select FLASH_PAGE_LAYOUT
	select FLASH_HAS_PAGE_LAYOUT
	select DMA if $(DT_STM32_MSPI_1_HAS_DMA) || $(DT_STM32_MSPI_2_HAS_DMA)
	select USE_STM32_HAL_DMA if $(DT_STM32_MSPI_1_HAS_DMA) || \
					$(DT_STM32_MSPI_2_HAS_DMA)
	select USE_STM32_HAL_DMA_EX if SOC_SERIES_STM32H5X && \
					($(DT_STM32_MSPI_1_HAS_DMA) || \
					 $(DT_STM32_MSPI_2_HAS_DMA))
	help
	  Enable MSPI and controller support on the STM32 family of processors.
```

## drivers/flash/Kconfig.stm32_ospi
```kconfig
# STM32 Octo SPI flash driver configuration options

# Copyright (c) 2022 STMicroelctronics
# SPDX-License-Identifier: Apache-2.0

DT_COMPAT_ST_STM32_OSPI_NOR := st,stm32-ospi-nor
DT_STM32_OCTOSPI_HAS_DMA := $(dt_nodelabel_has_prop,octospi1,dmas)

config FLASH_STM32_OSPI
	bool "STM32 Octo SPI Flash driver"
	depends on SOC_FAMILY_STM32
	default $(dt_compat_enabled,$(DT_COMPAT_ST_STM32_OSPI_NOR))
	select USE_STM32_HAL_OSPI
	select USE_STM32_LL_DLYB
	select USE_STM32_HAL_MDMA if SOC_SERIES_STM32H7X
	select FLASH_HAS_DRIVER_ENABLED
	select FLASH_JESD216
	select FLASH_PAGE_LAYOUT
	select DMA if $(DT_STM32_OCTOSPI_HAS_DMA)
	select USE_STM32_HAL_DMA if $(DT_STM32_OCTOSPI_HAS_DMA)
	select FLASH_HAS_PAGE_LAYOUT
	help
	  Enable OSPI-NOR support on the STM32 family of processors.
```

## drivers/serial/Kconfig.stm32
```kconfig
# STM32 UART configuration

# Copyright (c) 2016 Open-RnD Sp. z o.o.
# SPDX-License-Identifier: Apache-2.0

DT_COMPAT_ST_STM32_DMA_V1 := st,stm32-dma-v1
DT_COMPAT_ST_STM32_DMA_V2 := st,stm32-dma-v2

config UART_STM32
	bool "STM32 MCU serial driver"
	select SERIAL_HAS_DRIVER
	select SERIAL_SUPPORT_INTERRUPT
	# the ASYNC implementation requires a DMA controller
	select SERIAL_SUPPORT_ASYNC \
		if $(dt_compat_enabled,$(DT_COMPAT_ST_STM32_DMA_V1)) || \
		   $(dt_compat_enabled,$(DT_COMPAT_ST_STM32_DMA_V2))
	select DMA if UART_ASYNC_API
	depends on SOC_FAMILY_STM32
	help
	  This option enables the UART driver for STM32 family of
	  processors.
	  Say y if you wish to use serial port on STM32 MCU.

config UART_STM32_UNALIGNED_DMA
	bool "STM32 MCU UART Unaligned DMA Support"
	depends on UART_ASYNC_API
	depends on CPU_CORTEX_M7
	default y
	help
	  Support unaligned DMA buffer. When DMA buffers are not aligned on
	  cache line boundaries, or their size is not a multiple of the
	  the cache line size, the UART driver will use a temporary buffer
	  that is correctly aligned, so the user doesn't have to care
	  about it. This of course comes with the cost of an extra memcpy
	  so if the user is sure the UART buffers are all correctly aligned
	  the option can be disabled.
```

## dts/bindings/adc/st,stm32-adc.yaml
```yaml
# Copyright (c) 2018, Endre Karlson
# Copyright (c) 2018, Song Qiang <songqiang1304521@gmail.com>
# SPDX-License-Identifier: Apache-2.0

description: ST STM32 family ADC

compatible: "st,stm32-adc"

include: [adc-controller.yaml, pinctrl-device.yaml]

properties:
    reg:
      required: true

    clocks:
      required: true

    interrupts:
      required: true

    "#io-channel-cells":
      const: 1

    st,adc-prescaler:
      required: false
      type: array
      description: |
        The ADC Clock specifier at the input of the peripheral.
        On some series, it could be either ASYNChronous (derived from the domain clock)
        or SYNChronous (derived from the AHB or APB).
        In each case, a specific prescaler can be applied to reduce the input frequency.
        It is combined to the st,prescaler to define the exact ADC clock freq.
        Refer to the RefMan to know the possible schemes.
        The property must have two integer elements:
        - first:  SYNC or ASYNC to select synchronous or asynchronous specific clock
        - second: divider which is an integer from 1 to 256
        (some stm32 may have only limited nb of divider. For example on stm32F2 :
        SYNC of 4 (possibly 2, 4, 6, 8) will give st,prescaler = <SYNC 4>;

    pinctrl-0:
      required: true

    pinctrl-names:
      required: true

    vref-mv:
      type: int
      required: false
      default: 3300
      description: Indicates the reference voltage of the ADC in mV (on the target board).

    has-temp-channel:
      type: boolean
      description: Indicates if the ADC has a dedicated internal temperature sensor channel.

    has-vref-channel:
      type: boolean
      description: Indicates if the ADC has a dedicated internal voltage reference channel.

    has-vbat-channel:
      type: boolean
      description: Indicates if the ADC has a dedicated internal vbat monitoring channel.

io-channel-cells:
    - input
```

## dts/bindings/flash_controller/st,stm32-mspi-nor.yaml
```yaml
# Copyright (c) 2021, STMicroelectronics
# SPDX-License-Identifier: Apache-2.0

description: |
    STM32 MSPI Flash controller supporting the JEDEC CFI interface

    Representation of a serial flash on a octospi bus:

        mx25lm51245: ospi-nor-flash@70000000 {
                compatible = "st,stm32-mspi-nor";
                reg = <0x70000000 DT_SIZE_M(64)>; /* 512 Mbits */
                mspi-io-mode = <OSPI_OPI_MODE>; /* access on 8 data lines */
                mspi-data-rate = <OSPI_DTR_TRANSFER>; /* access in DTR */
                mspi-max-frequency = <DT_FREQ_M(50)>;
                status = "okay";
        };

compatible: "st,stm32-mspi-nor"

include: ["mspi-device.yaml", "flash-controller.yaml", "jedec,jesd216.yaml"]

on-bus: mspi

properties:
  reg:
    required: true
    description: Flash Memory base address and size in bytes
  mspi-io-mode:
    required: true
  mspi-data-rate:
    required: true
  rx-dummy:
    required: true
  tx-dummy:
    required: true
  read-command:
    required: true
  write-command:
    required: true
  command-length:
    required: true
  address-length:
    required: true
  reset-gpios:
    type: phandle-array
    description: RESETn pin
  reset-gpios-duration:
    type: int
    description: The duration (in ms) for the flash memory reset pulse
```

## dts/bindings/flash_controller/st,stm32-ospi-nor.yaml
```yaml
# Copyright (c) 2021, STMicroelectronics
# SPDX-License-Identifier: Apache-2.0

description: |
    STM32 OSPI Flash controller supporting the JEDEC CFI interface

    Representation of a serial flash on a octospi bus:

        mx25lm51245: ospi-nor-flash@0 {
                compatible = "st,stm32-ospi-nor";
                label = "MX25LM512";
                reg = <0>;
                data-mode = <8>; /* access on a 8 lines */
                data-rate = <1>; /* access in STR */
                ospi-max-frequency = <50000000>;
                size = <DT_SIZE_M(4)>; /* 512 KBytes */
                status = "okay";
        };

compatible: "st,stm32-ospi-nor"

include: ["flash-controller.yaml", "jedec,jesd216.yaml"]

on-bus: ospi

properties:
    reg:
      required: true
    ospi-max-frequency:
      type: int
      required: true
      description: Maximum clock frequency of device's OSPI interface in Hz
    label:
      required: true
    size:
      required: true
      description: Flash Memory size in bits
    reset-gpios:
      type: phandle-array
      required: false
      description: RESETn pin
    spi-bus-width:
      type: int
      default: 8
      required: false
      description: The width of (Octo)SPI bus to which flash memory is connected.
                   Now only value of 8 (default) or 1 (not really useful) are supported.
      enum:
        - 1 #  SPI mode
        - 8 #  Octo SPI mode
    data-rate:
      type: int
      required: true
      description: the SPI data Rate is STR or DTR (DTR is valid for OSPI only)
      enum:
        - 1 #  Single Transfer Rate
        - 2 #  Double Transfer Rate
```

## dts/bindings/mtd/mspi-aps256.yaml
```yaml
# Copyright (c) 2025 STMicroelectronics
# SPDX-License-Identifier: Apache-2.0

description: AP Memory APS256 pSRAM on MSPI bus

compatible: "mspi-aps256"

include: [mspi-device.yaml, "jedec,jesd216.yaml"]
```

## dts/bindings/mtd/mspi-aps6408l.yaml
```yaml
# Copyright (c) 2024, Ambiq Micro Inc. <www.ambiq.com>
# Copyright (c) 2025, STMicroelectronics
# SPDX-License-Identifier: Apache-2.0

description: AP Memory APS6408L pSRAM on MSPI bus

compatible: "mspi-aps6408l"

include: [mspi-device.yaml, "jedec,jesd216.yaml"]
```

## dts/bindings/ospi/st,stm32-ospi.yaml
```yaml
# Copyright (c) 2022 STMicroelectronics
# SPDX-License-Identifier: Apache-2.0

description: |
    STM32 OSPI device representation. A stm32 octospi node would typically
    looks to this:

        &octospi {
            pinctrl-0 = <&octospi_clk_pe9 &octospi_ncs_pe10 &octospi_dqs_pe11
                         &octospi_bk1_io0_pe12 &octospi_bk1_io1_pe13
                         &octospi_bk1_io2_pe14 &octospi_bk1_io3_pe15
                         &octospi_bk1_io4_pe16 &octospi_bk1_io5_pe17
                         &octospi_bk1_io6_pe18 &octospi_bk1_io7_pe19>;

            dmas = <&dma1 5 41 0x10000>;
            dma-names = "tx_rx";

            status = "okay";
        };

compatible: "st,stm32-ospi"

include: [base.yaml, pinctrl-device.yaml]

bus: ospi

properties:
    reg:
      required: true

    interrupts:
      required: true

    pinctrl-0:
      required: true

    pinctrl-names:
      required: true

    dmas:
      description: |
        Optional DMA channel specifier. If DMA should be used, specifier should
        hold a phandle reference to the dma controller, the channel number,
        the slot number, channel configuration and finally features.
        Even if a dmamux exists, the dma node is used (&dma1, &dma2)
        The dma channel is always given from 0 to Max-Channel minus 1
        The request is given by the DMAMUX if present : must be enabled in the DTS.
        Only the config bits priority and periph/mem datasize are used.
        The periph/mem datasize must be equal 0 is a correct value.
        There is no Fifo used by this DMA peripheral.

        For example dmas for TX/RX on OSPI
           dmas = <&dma1 5 41 0x10000>;

    dma-names:
      description: |
        DMA channel name. If DMA should be used, expected value is "tx_rx".

        For example
           dma-names = "tx_rx";

    flash-id:
      type: int
      required: false
      description: |
        FLash ID number. This number, if defined, helps to select the right
        OSPI GPIO banks (defined as 'octospi_bk[12]' in pinctrl property)
        to communicate with flash memory.

        For example
           flash-id = <1>;
```

## samples/application_development/code_relocation_nocopy/boards/b_u585i_iot02a_cpuapp.conf
```kconfig
CONFIG_FLASH=y

#use QSPI or OSPI, not SPI
CONFIG_SPI=n

CONFIG_STM32_MEMMAP=y
CONFIG_STM32_MEMMAP_EXT_FLASH_BASE_ADDRESS=0x70000000
```

## samples/application_development/code_relocation_nocopy/boards/stm32h7b3i_dk.conf
```kconfig
CONFIG_FLASH=y
CONFIG_SPI=n
CONFIG_LOG_MODE_IMMEDIATE=y

# OSPI NOR flash section provided by stm32h7 memory-region in dts.
CONFIG_HAVE_CUSTOM_LINKER_SCRIPT=n
```

## samples/boards/stm32/flash_error/sample.yaml
```yaml
sample:
  description: detect a RDSERR and/or RDPERR
  name: stm32_flash_error
tests:
  sample.boards.stm32.flash_error:
    filter: CONFIG_SOC_SERIES_STM32H7X
    platform_allow:
      - nucleo_h753zi
```

## samples/boards/stm32/h7_flash_m4/sample.yaml
```yaml
sample:
  name: SoC Flash on STM32H7
tests:
  sample.drivers.flash.st.stm32-nv-flash:
    platform_allow:
      - stm32h747i-disco_m7
    integration_platforms:
      - stm32h747i-disco_m7
    tags:
      - flash
      - stm32h747
```

## samples/boards/stm32/hello_world_xip/sample.yaml
```yaml
sample:
  description: Hello World sample, the simplest Zephyr from external flash
    application
  name: hello world xip
tests:
  sample.boards.stm32.hello_world_xip:
    depends_on: backup_sram
    filter: dt_compat_enabled("st,stm32-ospi-nor") || dt_compat_enabled("st,stm32-qspi-nor")
    harness: console
    harness_config:
     type: one_line
      regex:
        - "Hello World! from external flash (.*)"
    integration_platforms:
      - b_u585i_iot02a
    platform_allow:
      - b_u585i_iot02a
      - stm32h7b3i_dk
      - stm32h735g_disco
```

## samples/boards/stm32/i2c_V2_timing/testcase.yaml
```yaml
tests:
  drivers.i2c.api:
    depends_on: i2c
    tags:
      - drivers
      - i2c
    filter: dt_compat("st,stm32-i2c-v2")
```

## samples/boards/stm32/memmap/testcase.yaml
```yaml
common:
  tags:
    - drivers
    - flash
tests:
  drivers.flash.stm32.memmap:
    platform_allow:
      - b_u585i_iot02a
      - stm32h7b3i_dk
      - stm32h735g_disco
    extra_configs:
      - CONFIG_FLASH_STM32_READOUT_PROTECTION=y
    filter: dt_compat_enabled("st,stm32-ospi-nor")
```

## samples/boards/stm32/power_mgmt/blinky/boards/nucleo_wb55rg.conf
```kconfig
# set the CONFIG_SYS_CLOCK_TICKS_PER_SEC depends on the LPTIM prescaler
# with a LPTIM1 prescaler of <1> to <8>, set the CONFIG_SYS_CLOCK_TICKS_PER_SEC to 4096
# with a LPTIM1 prescaler of <16>, set the CONFIG_SYS_CLOCK_TICKS_PER_SEC to 2048
# with a LPTIM1 prescaler of <32>, set the CONFIG_SYS_CLOCK_TICKS_PER_SEC to 1024
CONFIG_SYS_CLOCK_TICKS_PER_SEC=1024

# also set the CONFIG_STM32_LPTIM_CLOCK_LSE
# to match the <clocks> property of the lptim1 node in the DTS
CONFIG_STM32_LPTIM_CLOCK_LSE=y
```

## samples/drivers/mspi/mspi_flash/boards/stm32h573i_dk.conf
```kconfig
# Copyright (c) 2024 STMicroelectronics
# SPDX-License-Identifier: Apache-2.0


CONFIG_LOG=y
CONFIG_FLASH_LOG_LEVEL_DBG=y

CONFIG_FLASH_MSPI_STM32=y
```

## samples/subsys/fs/littlefs/boards/stm32h747i_disco_m7.conf
```kconfig
#
# Copyright (c) 2022 Christoph Heller
#
# SPDX-License-Identifier: Apache-2.0

CONFIG_FS_LITTLEFS_FC_HEAP_SIZE=8192
CONFIG_COMMON_LIBC_MALLOC_ARENA_SIZE=256
```

## samples/subsys/power/stm32_pm/device_pm/sample.yaml
```yaml
sample:
  name: Low Power State Sample for nucleo_l4r5zi
tests:
  sample.subsys.power.stm32_power.low_power_state:
    platform_whitelist: nucleo_l4r5zi
    timeout: 150
    tags: power
    harness: console
    harness_config:
      type: multi_line
      regex:
        - "--> Entering to SYS_POWER_STATE_SLEEP_3 state."
        - "--> Exited from SYS_POWER_STATE_SLEEP_3 state."
        - "--> Entering to SYS_POWER_STATE_SLEEP_2 state."
        - "--> Exited from SYS_POWER_STATE_SLEEP_2 state."
        - "--> Entering to SYS_POWER_STATE_SLEEP_1 state."
        - "--> Exited from SYS_POWER_STATE_SLEEP_1 state."
```
