/*
 * Copyright (c) 2023 STMicroelectronics
 *
 * SPDX-License-Identifier: Apache-2.0
 */

#include <st/h5/stm32h563.dtsi>

/ {
	soc {
		compatible = "st,stm32h573", "st,stm32h5", "simple-bus";

		aes: aes@420c0000 {
			compatible = "st,stm32-aes";
			reg = <0x420c0000 0x400>;
			clocks = <&rcc STM32_CLOCK(AHB2, 16)>;
			resets = <&rctl STM32_RESET(AHB2, 16)>;
			interrupts = <116 0>;
			status = "disabled";
		};
	};
};
