/*
 * Copyright (c) 2024 STMicroelectronics
 *
 * SPDX-License-Identifier: Apache-2.0
 */

/ {
	chosen {
		zephyr,flash = &mx66uw1g45a;
		zephyr,code-partition = &slot0_partition;
	};
	
	aliases {
		led0 = &blue_led;
		led1 = &orange_led;
		led2 = &green_led;
	};
};
