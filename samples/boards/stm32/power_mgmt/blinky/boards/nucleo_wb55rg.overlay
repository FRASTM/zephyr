 /*
  * give a prescaler to the lptim clock : LSE / 32 = 1024Hz
  * so that the sleep period is of 64s in the sample application
  * with a LPTIM1 prescaler of <1> to <8>, set the CONFIG_SYS_CLOCK_TICKS_PER_SEC to 4096
  * with a LPTIM1 prescaler of <16>, set the CONFIG_SYS_CLOCK_TICKS_PER_SEC to 2048
  * with a LPTIM1 prescaler of <32>, set the CONFIG_SYS_CLOCK_TICKS_PER_SEC to 1024
  */

&lptim1 {
	st,prescaler = <32>;
};
