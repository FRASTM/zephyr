/*
 * Copyright (c) 2022 STMicroelectronics
 *
 * SPDX-License-Identifier: Apache-2.0
 */
/ {
	chosen {
		/* Comment out these lines to use usart1 as console/shell */
		zephyr,console = &lpuart1;
		zephyr,shell-uart = &lpuart1;
	};
};

&clk_lse {
	status = "okay";
};

&lpuart1 {
	/delete-property/ hw-flow-control;
	/delete-property/ current-speed;

	current-speed = <9600>;
	/delete-property/ clock;
	clocks = <&rcc STM32_CLOCK_BUS_APB1_2 0x00000001>,
		 <&rcc STM32_SRC_LSE LPUART1_SEL(3)>;

	wakeup-source;
};
