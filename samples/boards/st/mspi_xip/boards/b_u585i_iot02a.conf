## samples/boards/st/mspi_xip/boards/b_u585i_iot02a.conf
```kconfig
# SPDX-FileCopyrightText: Copyright The Zephyr Project Contributors
# SPDX-License-Identifier: Apache-2.0

CONFIG_FLASH=y
CONFIG_MSPI_MEMMAP=y
CONFIG_MSPI_DMA=n
CONFIG_HEAP_MEM_POOL_SIZE=8192
```
