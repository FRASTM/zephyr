/*
 * Copyright (c) 2022 STMicroelectronics
 *
 * SPDX-License-Identifier: Apache-2.0
 *
 * Application overlay for creating temperature sensor device instance
 */

/ {
	stm-vbat {
		compatible = "st,stm32-vbat";
		ratio = <4>;
		io-channels = <&adc3 17>;
		status = "okay";
		label = "VBAT";
	};
};

&adc3 {
	pinctrl-0 = <&adc3_inp10_pc0>;
	pinctrl-names = "default";
	has-vbat-channel;
	vref-mv = <3300>;
	status = "okay";
};
