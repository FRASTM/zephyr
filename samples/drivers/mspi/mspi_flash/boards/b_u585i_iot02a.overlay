/*
 * Copyright (c) 2025 EXALT Technologies.
 * Copyright (c) 2026 STMicroelectronics
 *
 * SPDX-License-Identifier: Apache-2.0
 */

/ {
	aliases {
		/* The sample gets the DT_ALIAS(flash0) as the mspi device */
		flash0 = &mx25lm51245;
	};
};

&octospi2 {
	dmas = <&gpdma1 12 41 0x10480>; /* request 41 for OCTOSPI2 */
 	dma-names = "tx_rx";
};